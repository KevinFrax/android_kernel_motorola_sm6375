## drivers/input/touchscreen/touchscreen_mmi/Kconfig
```kconfig
config INPUT_TOUCHSCREEN_MMI
	tristate "Moto touchscreen gestures"
	default n
	help
	 Say Y here if you wish to include support for Moto touchscreen gestures.
	 If unsure, say N.

config TOUCHCLASS_MMI_DEBUG_INFO
	bool "Moto touchscreen gestures debug info"
	depends on INPUT_TOUCHSCREEN_MMI
	default n
	help
	 Say Y here if you wish to include support for Moto touchscreen gestures debugging info.
	 If unsure, say N.

config TOUCHCLASS_MMI_GESTURE_POISON_EVENT
	bool "Moto gestures event poison"
	depends on INPUT_TOUCHSCREEN_MMI
	default n
	help
	 Say Y here if you wish to include support for Moto gestures event poison.
	 If unsure, say N.

config DRM_PANEL_NOTIFICATIONS
	bool "DRM Panel Notifications"
	depends on INPUT_TOUCHSCREEN_MMI
	default n
	help
	 Say Y here if you wish to include support for Moto gestures event poison.
	 If unsure, say N.

config TOUCHCLASS_MMI_MULTIWAY_UPDATE_FW
      bool "Touchscreen Update FW"
	depends on INPUT_TOUCHSCREEN_MMI
	default n
	help
	 Say Y here if you wish to include support for Moto gestures event poison.
	 If unsure, say N.

config TS_KERNEL_USE_GKI
      bool "Touchscreen GKI"
     	depends on INPUT_TOUCHSCREEN_MMI
	default n
	help
	 Say Y here if you wish to include support for Moto gestures event poison.
	 If unsure, say N.
```

## drivers/power/bq2589x_chg_mmi/Kconfig
```kconfig
config MMI_BQ2589X
        tristate "MMI BQ2589X"
        select MMI_DISCRETE_CHARGER
        default n
        help
         Say Y here if you have a mmi bq2589x compatible
         device connected.

         This driver can also be built as a module.  If so, the module
         will be called bq2589x_charger.
```

## drivers/power/mmi_discrete_charger/Kconfig
```kconfig
config MMI_DISCRETE_CHARGER
        tristate "MMI discrete charger"
        select MMI_CHARGER
        select TYPEC_ADAPTER_CLASS
        default n
        help
         Say Y here if you have a mmi discrete compatible
         device connected.

         This driver can also be built as a module.  If so, the module
         will be called mmi_discrete_charger.
```

## drivers/power/mmi_discrete_turbo_charger/Kconfig
```kconfig
config MMI_DISCRETE_TURBO_CHARGER
        tristate "MMI discrete turbo charger"
        default n
        help
         Say Y here if you have a mmi discrete turbo compatible
         device connected.

         This driver can also be built as a module.  If so, the module
         will be called mmi_discrete_turbo_charger.
```

## drivers/power/sgm4154x_chg_mmi/Kconfig
```kconfig
config MMI_SGM4154X
        tristate "MMI SGM4154X"
        select MMI_DISCRETE_CHARGER
        default n
        help
         Say Y here if you have a mmi sgm4154x compatible
         device connected.

         This driver can also be built as a module.  If so, the module
         will be called sgm4154x_charger.
```
